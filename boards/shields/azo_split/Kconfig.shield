## boards/shields/azo_split/Kconfig.shield
```kconfig
config SHIELD_AZO_SPLIT_LEFT
    def_bool $(shields_list_contains,azo_split_left)

config SHIELD_AZO_SPLIT_RIGHT
    def_bool $(shields_list_contains,azo_split_right) 
```

## config/boards/shields/azo_split/Kconfig.defconfig
```kconfig
if SHIELD_AZO_SPLIT_LEFT

config ZMK_KEYBOARD_NAME
    default "AZO Split"

endif

if SHIELD_AZO_SPLIT_RIGHT

config ZMK_KEYBOARD_NAME
    default "AZO Split Right"

config ZMK_SPLIT_ROLE_CENTRAL
    default y

config I2C
    default y

menuconfig AZOTEQ_TPS43
    bool "Azoteq TPS43 Touchpad"
    depends on I2C
    help
      Enable driver for Azoteq TPS43 I2C touchpad

if AZOTEQ_TPS43

config AZOTEQ_TPS43_INIT_PRIORITY
    int "Init priority"
    default 75
    help
      Device driver initialization priority

endif # AZOTEQ_TPS43

endif 
```
